## sdkconfig.defaults
```kconfig
# 基础硬件频率飙到 240MHz
CONFIG_ESP32S3_DEFAULT_CPU_FREQ_240=y
CONFIG_ESP32S3_DEFAULT_CPU_FREQ_MHZ=240

# 彻底开启外部 PSRAM 硬件支持
CONFIG_SPIRAM=y
CONFIG_SPIRAM_TYPE_AUTO=y
CONFIG_SPIRAM_MODE_OCT=y
CONFIG_SPIRAM_SPEED_80M=y
CONFIG_SPIRAM_BOOT_INIT=y
CONFIG_SPIRAM_USE_MALLOC=y
CONFIG_SPIRAM_MALLOC_ALWAYSINTERNAL=64

# 修复 Wi-Fi 与 PSRAM 冲突的核心安全补丁
CONFIG_SPIRAM_TRY_ALLOCATE_WIFI_LWIP=y

# ====== 强制锁死 Bluedroid 协议栈及 GATT Client ======
CONFIG_BT_ENABLED=y
CONFIG_BT_NIMBLE_ENABLED=n
CONFIG_BT_BLUEDROID_ENABLED=y
CONFIG_BT_CLASSIC_ENABLED=n
CONFIG_BT_BLE_ENABLED=y
CONFIG_BT_GATTC_ENABLE=y
# 关闭用不到的服务端节省珍贵的内存
CONFIG_BT_GATTS_ENABLE=n
#开启BLE4.2兼容层
CONFIG_BT_BLE_42_FEATURES_SUPPORTED=y
# ======================================================

# ====== FreeRTOS 双核 SMP 配置 ======
# 启用对称多处理（SMP）模式，支持多核任务调度
#CONFIG_FREERTOS_SMP=y
# 明确关闭单核模式
# CONFIG_FREERTOS_UNICORE is not set
# 配置 FreeRTOS 支持双核
CONFIG_FREERTOS_NUMBER_OF_CORES=2
# ====================================
```
